/*
 * drivers/model.c — TinyML int8 neural network for frost probability
 *
 * A 3-layer fully-connected network (8 → 16 → 8 → 1 sigmoid) quantized
 * to int8.  Trained offline on historical frost events using sky IR,
 * wet-bulb, leaf wetness, radiative deficit, hour-of-night, wind,
 * dry-bulb, and RH as inputs.  Inference runs in ~2.4 ms on the
 * Cortex-M33 at 160 MHz.
 *
 * The model weights are stored as int8 arrays in Flash.  The forward
 * pass uses integer-only arithmetic with requantization between layers.
 *
 * Author: jayis1
 * Copyright (C) 2026 jayis1. All rights reserved.
 * License: GPL-3.0
 */

#include "model.h"
#include "../board.h"

/* ------------------------------------------------------------------ */
/*  Network dimensions                                                 */
/* ------------------------------------------------------------------ */
#define INPUT_SIZE      8
#define HIDDEN1_SIZE    16
#define HIDDEN2_SIZE    8
#define OUTPUT_SIZE     1

/* ------------------------------------------------------------------ */
/*  Pre-trained int8 weights (placeholder synthetic weights)          */
/*  In production these are generated by the training pipeline and     */
/*  exported as a C array.  The values below are hand-tuned heuristics */
/*  that approximate the trained model's behavior for the fusion demo. */
/* ------------------------------------------------------------------ */

/* Input → Hidden1 weights (16 × 8 = 128 int8 values) */
static const int8_t W1[HIDDEN1_SIZE][INPUT_SIZE] = {
    /* h1: radiative deficit contribution (sky IR) */
    {-12, -2,  0,  0,  2,  0,  1,  0},
    /* h2: wet-bulb proximity to 0 °C */
    {  0,-15,  0,  0,  0,  0, -3,  0},
    /* h3: leaf wetness present */
    {  0,  0,  8,  0,  0,  0,  0,  0},
    /* h4: hour-of-night (late night = higher risk) */
    {  0,  0,  0,  6,  0,  0,  0,  0},
    /* h5: wind speed (low wind = higher risk) */
    {  0,  0,  0,  0,-10,  0,  0,  0},
    /* h6: dry-bulb temperature (low = higher risk) */
    { -3,  0,  0,  0,  0,  0,-10,  0},
    /* h7: relative humidity (high = higher risk) */
    {  0,  0,  0,  0,  0,  0,  0,  5},
    /* h8: combined sky+wetbulb interaction */
    { -6, -6,  0,  0, -2,  0, -2,  2},
    /* h9: wetbulb × wetness */
    {  0, -4,  4,  0,  0,  0, -2,  0},
    /* h10: sky × hour */
    { -4,  0,  0,  2,  0,  0,  0,  0},
    /* h11: low temp × high RH */
    {  0,  0,  0,  0,  0, -3,  0,  3},
    /* h12: all-negative bias (baseline risk) */
    { -2, -2,  1,  1, -1, -2, -1,  1},
    /* h13: wetbulb strongly negative */
    {  0,-12,  0,  0,  0,  0, -4,  0},
    /* h14: sky strongly negative */
    {-10,  0,  0,  0,  0,  0,  0,  0},
    /* h15: hour late + wind low */
    {  0,  0,  0,  3, -6,  0,  0,  0},
    /* h16: wetness + dewpoint proxy */
    {  0, -2,  3,  0,  0, -1,  0,  2}
};

/* Hidden1 biases (16 int8) */
static const int8_t B1[HIDDEN1_SIZE] = {
    10, 20, -15, 15, 20, 15, -10, 25,
    10, 10, 5, 10, 25, 20, 15, 10
};

/* Hidden1 → Hidden2 weights (8 × 16 = 128 int8) */
static const int8_t W2[HIDDEN2_SIZE][HIDDEN1_SIZE] = {
    /* combining primary frost indicators */
    {  8, 10,  6,  4,  5,  6,  3, 12,
       8,  4,  3,  2,  8,  7,  4,  5},
    /* wet-bulb dominant */
    {  2, 12,  4,  2,  2,  4,  2,  6,
       8,  2,  2,  2, 10,  2,  2,  4},
    /* sky IR dominant */
    { 10,  2,  2,  2,  2,  2,  2,  4,
       2,  6,  2,  2,  2,  8,  2,  2},
    /* wetness + hour */
    {  2,  2,  8,  6,  2,  2,  2,  4,
       6,  4,  2,  2,  2,  2,  4,  4},
    /* all-factor combination */
    {  4,  4,  3,  3,  3,  3,  2,  6,
       4,  3,  2,  2,  4,  4,  3,  3},
    /* negative bias suppressor */
    { -2, -2, -1, -1, -1, -1, -1, -2,
      -1, -1, -1, -1, -2, -2, -1, -1},
    /* late-night + cold */
    {  2,  4,  2,  6,  2,  4,  2,  4,
       2,  4,  2,  2,  4,  2,  4,  2},
    /* wind interaction suppressor */
    {  2,  2,  2,  2, -8,  2,  2,  2,
       2,  2,  2,  2,  2,  2, -4,  2}
};

/* Hidden2 biases (8 int8) */
static const int8_t B2[HIDDEN2_SIZE] = {
    -10, -5, -5, -8, -15, 20, -8, 10
};

/* Hidden2 → Output weights (1 × 8) */
static const int8_t W3[OUTPUT_SIZE][HIDDEN2_SIZE] = {
    {  6,  8,  8,  6, 10, -4,  6, -3}
};

/* Output bias */
static const int8_t B3[OUTPUT_SIZE] = { -8 };

/* ------------------------------------------------------------------ */
/*  Requantization helper: int32 accumulator → int8                    */
/*  Scale: we use a fixed scale of 1/128 (shift right 7)              */
/* ------------------------------------------------------------------ */
static int8_t requantize(int32_t acc, int8_t bias)
{
    acc += (int32_t)bias << 7;  /* scale bias to accumulator range */
    acc >>= 7;                   /* requantize to int8 */
    /* Clamp to int8 range */
    if (acc > 127)  acc = 127;
    if (acc < -128) acc = -128;
    return (int8_t)acc;
}

/* ReLU activation */
static int8_t relu(int8_t x)
{
    return (x < 0) ? 0 : x;
}

/* Sigmoid approximation (output layer) → Q8.8 fixed-point */
static int16_t sigmoid_q8(int32_t x)
{
    /* x is in int8-scaled accumulator; shift to Q8.8 range */
    /* sigmoid(x/16) approximated via piecewise linear:
     *   x < -64: 0
     *   x >  64: 256 (1.0 in Q8.8)
     *   linear between -64 and 64: 128 + x*2
     */
    if (x < -64) return 0;
    if (x >  64) return 256;
    return (int16_t)(128 + x * 2);
}

/* ------------------------------------------------------------------ */
/*  Forward pass                                                       */
/*                                                                    */
/*  Inputs (all int8, scaled -128..127):                              */
/*    [0] sky_t_c    : -128=-40°C, 0=0°C, 127=~50°C                   */
/*    [1] twet_c     : same scale                                     */
/*    [2] leaf_wet   : 0=dry, 127=saturated                           */
/*    [3] hour       : 0=midnight, 127=next midnight (scaled)         */
/*    [4] wind_ms    : 0=calm, 127=high wind                          */
/*    [5] tdry_c     : same scale as [0]                              */
/*    [6] tdry_c     : duplicate for bias (unused, set 0)             */
/*    [7] rh         : 0=0%, 127=100%                                 */
/*                                                                    */
/*  Returns frost probability in Q8.8 (0..256 = 0.0..1.0).            */
/* ------------------------------------------------------------------ */
int16_t model_infer(const int8_t inputs[INPUT_SIZE])
{
    int8_t h1[HIDDEN1_SIZE];
    int8_t h2[HIDDEN2_SIZE];
    int32_t acc;

    /* Layer 1: input → hidden1 */
    for (int j = 0; j < HIDDEN1_SIZE; j++) {
        acc = 0;
        for (int i = 0; i < INPUT_SIZE; i++) {
            acc += (int32_t)W1[j][i] * inputs[i];
        }
        h1[j] = relu(requantize(acc, B1[j]));
    }

    /* Layer 2: hidden1 → hidden2 */
    for (int j = 0; j < HIDDEN2_SIZE; j++) {
        acc = 0;
        for (int i = 0; i < HIDDEN1_SIZE; i++) {
            acc += (int32_t)W2[j][i] * h1[i];
        }
        h2[j] = relu(requantize(acc, B2[j]));
    }

    /* Layer 3: hidden2 → output (sigmoid) */
    acc = 0;
    for (int i = 0; i < HIDDEN2_SIZE; i++) {
        acc += (int32_t)W3[0][i] * h2[i];
    }
    acc += (int32_t)B3[0] << 7;

    return sigmoid_q8(acc >> 7);
}

/* ------------------------------------------------------------------ */
/*  Public: compute frost probability from sensor readings             */
/*                                                                    */
/*  Takes the current sensor state from g_sys and produces a Q8.8     */
/*  frost probability (0..256).                                       */
/* ------------------------------------------------------------------ */
int16_t model_compute_frost_probability(void)
{
    int8_t inputs[INPUT_SIZE];

    /* Scale sensor values to int8 range */
    /* sky_t: -40°C..50°C → -128..127 ; scale = (val + 40) * 127 / 90 */
    int32_t sky_c = g_sys.sky_t_cx100 / 100;
    inputs[0] = (int8_t)((sky_c + 40) * 127 / 90);
    if (inputs[0] < -128) inputs[0] = -128;
    if (inputs[0] > 127)  inputs[0] = 127;

    /* twet: same scale */
    int32_t twet_c = g_sys.twet_cx100 / 100;
    inputs[1] = (int8_t)((twet_c + 40) * 127 / 90);
    if (inputs[1] < -128) inputs[1] = -128;
    if (inputs[1] > 127)  inputs[1] = 127;

    /* leaf_wet: 0..1000 → 0..127 */
    inputs[2] = (int8_t)(g_sys.leaf_wet * 127 / 1000);

    /* hour: 0..23 → 0..127 (midnight=0, noon=127) */
    uint32_t epoch = g_rtc_seconds;
    uint8_t hour = (epoch / 3600) % 24;
    inputs[3] = (int8_t)(hour * 127 / 23);

    /* wind: not directly measured; use proxy from ΔT_rad stability
     * (high ΔT_rad + low wind = frost).  We set wind=0 (calm) as a
     * worst-case when ΔT_rad > 20 K, otherwise wind=64. */
    int32_t delta_rad = g_sys.delta_rad_cx100 / 100;
    inputs[4] = (delta_rad > 20) ? 0 : 64;

    /* tdry */
    int32_t tdry_c = g_sys.air_t_cx100 / 100;
    inputs[5] = (int8_t)((tdry_c + 40) * 127 / 90);
    if (inputs[5] < -128) inputs[5] = -128;
    if (inputs[5] > 127)  inputs[5] = 127;

    /* unused channel */
    inputs[6] = 0;

    /* RH: approximate from wet-bulb depression (high depression = low RH) */
    /* crude: rh = 100 - depression*10 ; clamp */
    int32_t depression = (g_sys.air_t_cx100 - g_sys.twet_cx100) / 100;
    int32_t rh = 100 - depression * 10;
    if (rh < 0) rh = 0;
    if (rh > 100) rh = 100;
    inputs[7] = (int8_t)(rh * 127 / 100);

    return model_infer(inputs);
}