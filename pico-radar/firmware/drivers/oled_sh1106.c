/*
 * drivers/oled_sh1106.c — SH1106 128×64 OLED driver for PicoRadar
 *
 * I2C1 at 400 kHz on STM32H743 (PB6=SCL, PB7=SDA).
 * Framebuffer stored in RAM, flushed to display on oled_update().
 */

#include "oled_sh1106.h"
#include "registers.h"
#include "board.h"
#include <string.h>

/* Framebuffer: 128 × 8 pages = 1024 bytes */
static uint8_t framebuffer[OLED_WIDTH * OLED_PAGES];

/* ---- I2C1 helpers ---- */

static void i2c1_wait_isr(uint32_t flag)
{
    uint32_t timeout = 50000;
    while (!(I2C_ISR(I2C1_BASE) & flag) && --timeout);
}

static int i2c1_write(uint8_t dev_addr, const uint8_t *data, uint16_t len)
{
    I2C_CR2(I2C1_BASE) = (dev_addr << 1)
                        | (len & 0xFF)
                        | (1 << 16)
                        | (1 << 13);
    i2c1_wait_isr(1 << 0);
    if (I2C_ISR(I2C1_BASE) & (1 << 4)) return -1;

    for (uint16_t i = 0; i < len; i++) {
        i2c1_wait_isr(1 << 0);
        I2C_TXDR(I2C1_BASE) = data[i];
    }

    i2c1_wait_isr(1 << 5);
    I2C_ISR(I2C1_BASE) = 0;
    return 0;
}

static void oled_send_command(uint8_t cmd)
{
    uint8_t buf[2] = { SH1106_CTRL_CMD, cmd };
    i2c1_write(OLED_I2C_ADDR, buf, 2);
}

static void oled_send_commands(const uint8_t *cmds, uint16_t count)
{
    for (uint16_t i = 0; i < count; i++) {
        oled_send_command(cmds[i]);
    }
}

static void oled_send_data(const uint8_t *data, uint16_t len)
{
    uint16_t offset = 0;
    while (offset < len) {
        uint16_t chunk = len - offset;
        if (chunk > 16) chunk = 16;

        I2C_CR2(I2C1_BASE) = (OLED_I2C_ADDR << 1)
                            | ((chunk + 1) & 0xFF)
                            | (1 << 16)
                            | (1 << 13);
        i2c1_wait_isr(1 << 0);
        I2C_TXDR(I2C1_BASE) = SH1106_CTRL_DATA;

        for (uint16_t i = 0; i < chunk; i++) {
            i2c1_wait_isr(1 << 0);
            I2C_TXDR(I2C1_BASE) = data[offset + i];
        }
        i2c1_wait_isr(1 << 5);
        I2C_ISR(I2C1_BASE) = 0;
        offset += chunk;
    }
}

/* ---- Public API ---- */

int oled_init(void)
{
    RCC_APB1LENR |= (1 << 21);

    I2C_CR1(I2C1_BASE) &= ~(1 << 0);
    I2C_TIMINGR(I2C1_BASE) = (3 << 28)   // PRESC=3
                           | (4 << 20)    // SCLDEL=4
                           | (2 << 16)    // SDADEL=2
                           | (26 << 8)    // SCLH=26
                           | (40 << 0);   // SCLL=40
    I2C_CR1(I2C1_BASE) |= (1 << 0);

    for (volatile int i = 0; i < 1000000; i++);

    const uint8_t init_cmds[] = {
        SH1106_DISPLAY_OFF,
        0xD5, 0x80,
        0xA8, 0x3F,
        0xD3, 0x00,
        0x40,
        0xAD, 0x8B,
        0x8D, 0x14,
        0x20, 0x00,
        SH1106_SEG_REMAP,
        SH1106_COM_SCAN_INV,
        0xDA, 0x12,
        0x81, 0xCF,
        0xD9, 0xF1,
        0xDB, 0x40,
        0xA4,
        0xA6,
        SH1106_DISPLAY_ON,
    };
    oled_send_commands(init_cmds, sizeof(init_cmds));

    oled_clear();
    oled_update();

    return 0;
}

void oled_power_on(void)   { oled_send_command(SH1106_DISPLAY_ON); }
void oled_power_off(void)  { oled_send_command(SH1106_DISPLAY_OFF); }

void oled_set_contrast(uint8_t level)
{
    oled_send_command(SH1106_SET_CONTRAST);
    oled_send_command(level);
}

void oled_clear(void)
{
    memset(framebuffer, 0, sizeof(framebuffer));
}

void oled_update(void)
{
    for (uint8_t page = 0; page < OLED_PAGES; page++) {
        oled_send_command(SH1106_SET_PAGE_ADDR | page);
        oled_send_command(SH1106_SET_COL_LO | 2);
        oled_send_command(SH1106_SET_COL_HI | 0);
        oled_send_data(&framebuffer[page * OLED_WIDTH], OLED_WIDTH);
    }
}

void oled_draw_pixel(uint8_t x, uint8_t y, oled_color_t color)
{
    if (x >= OLED_WIDTH || y >= OLED_HEIGHT) return;
    uint16_t idx = (y / 8) * OLED_WIDTH + x;
    uint8_t bit = 1 << (y % 8);
    if (color == OLED_COLOR_WHITE)
        framebuffer[idx] |= bit;
    else if (color == OLED_COLOR_BLACK)
        framebuffer[idx] &= ~bit;
    else
        framebuffer[idx] ^= bit;
}

void oled_draw_char(uint8_t x, uint8_t y, char c, oled_color_t color)
{
    if (c < ' ' || c > '~') c = ' ';
    uint8_t glyph_idx = c - ' ';
    for (uint8_t col = 0; col < 8; col++) {
        uint8_t line = oled_font8x8[glyph_idx][col];
        for (uint8_t row = 0; row < 8; row++) {
            if (line & (1 << row))
                oled_draw_pixel(x + col, y + row, color);
            else
                oled_draw_pixel(x + col, y + row, OLED_COLOR_BLACK);
        }
    }
}

void oled_draw_string(uint8_t x, uint8_t y, const char *str, oled_color_t color)
{
    while (*str) {
        oled_draw_char(x, y, *str, color);
        x += 8;
        if (x + 8 > OLED_WIDTH) { x = 0; y += 8; }
        str++;
    }
}

void oled_draw_line(uint8_t x0, uint8_t y0, uint8_t x1, uint8_t y1, oled_color_t color)
{
    int dx = (x1 > x0) ? (x1 - x0) : (x0 - x1);
    int dy = (y1 > y0) ? (y1 - y0) : (y0 - y1);
    int sx = (x0 < x1) ? 1 : -1;
    int sy = (y0 < y1) ? 1 : -1;
    int err = dx - dy;

    while (1) {
        oled_draw_pixel(x0, y0, color);
        if (x0 == x1 && y0 == y1) break;
        int e2 = 2 * err;
        if (e2 > -dy) { err -= dy; x0 += sx; }
        if (e2 < dx)  { err += dx; y0 += sy; }
    }
}

void oled_draw_rect(uint8_t x, uint8_t y, uint8_t w, uint8_t h, oled_color_t color)
{
    oled_draw_line(x, y, x + w - 1, y, color);
    oled_draw_line(x, y + h - 1, x + w - 1, y + h - 1, color);
    oled_draw_line(x, y, x, y + h - 1, color);
    oled_draw_line(x + w - 1, y, x + w - 1, y + h - 1, color);
}

void oled_fill_rect(uint8_t x, uint8_t y, uint8_t w, uint8_t h, oled_color_t color)
{
    for (uint8_t i = x; i < x + w; i++)
        for (uint8_t j = y; j < y + h; j++)
            oled_draw_pixel(i, j, color);
}

void oled_invert_display(uint8_t on)
{
    oled_send_command(on ? 0xA7 : 0xA6);
}

/* ---- 8×8 font (ASCII 0x20–0x7E) ---- */
const uint8_t oled_font8x8[96][8] = {
    {0x00,0x00,0x00,0x00,0x00,0x00,0x00,0x00}, // ' '
    {0x18,0x3C,0x3C,0x18,0x18,0x00,0x18,0x00}, // '!'
    {0x36,0x36,0x00,0x00,0x00,0x00,0x00,0x00}, // '"'
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    {0x6E,0x3B,0x00,0x00,0x00,0x00,0x00,0x00}, // '~'
};