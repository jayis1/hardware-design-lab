/*
 * tflite.c — Tiny int8 1-D CNN inference engine for stroke classification
 * Author: jayis1
 * Copyright (c) 2026 jayis1 — MIT License
 *
 * Network topology (int8 quantized, CMSIS-NN-compatible shapes):
 *
 *   input   : 64 × 3   int8
 *   conv1   : Conv1D(8,  k=5, stride=1, ReLU)   out: 64 × 8
 *   conv2   : Conv1D(16, k=5, stride=2, ReLU)  out: 32 × 16
 *   conv3   : Conv1D(32, k=3, stride=2, ReLU)  out: 16 × 32
 *   conv4   : Conv1D(64, k=3, stride=1, ReLU)  out: 16 × 64
 *   pool    : average over time                    out: 64
 *   fc      : Linear(64 → 56)                       out: 56 logits
 *
 * Weight layout in the blob (big chunks; see `glyphflow_weights_default`):
 *   conv1_w[8*3*5]   conv1_b[8]
 *   conv2_w[16*8*5]  conv2_b[16]
 *   conv3_w[32*16*3] conv3_b[32]
 *   conv4_w[64*32*3] conv4_b[64]
 *   fc_w[56*64]      fc_b[56]
 * Total int8 weights: 120 + 640 + 1536 + 6144 + 3584 = 12024
 * Total int16/32 biases (stored as int32 scaled): 8+16+32+64+56 = 176 × 4 = 704 B
 *
 * For real deployments this blob is replaced via BLE OTA. Here we ship a
 * deterministic placeholder blob so the firmware has a self-contained
 * reference; the placeholder produces a valid but untrained output (the
 * classification layer is exercised; accuracy is random until trained).
 */
#include "tflite.h"
#include "../board.h"
#include <string.h>

/* ---- Placeholder weight blob ------------------------------------- */
/* Generated by a Python script (not shown); values are small random int8.
 * In a trained build this array lives at 0x08008000 and is ~12.2 KB. */
#define W_CONV1  (8*3*5)
#define W_CONV2  (16*8*5)
#define W_CONV3  (32*16*3)
#define W_CONV4  (64*32*3)
#define W_FC     (56*64)
#define TOTAL_W  (W_CONV1 + W_CONV2 + W_CONV3 + W_CONV4 + W_FC)

static const int8_t g_weights[TOTAL_W] = {
    /* conv1: 120 values */
     3,-1, 2, 0, 1,  -2, 1, 0, 3,-1,   1, 0,-1, 2, 1,   0, 2,-3, 1, 0,
     1,-2, 3, 0,-1,   2, 1, 0,-1, 2,  -1, 0, 1, 2,-1,   3, 0,-2, 1, 0,
     0, 1,-1, 2, 1,  -1, 2, 0, 1,-1,   1, 0, 2,-1, 0,  -2, 1, 0, 3,-1,
     2,-1, 0, 1, 2,   0,-1, 2, 1,-1,   1, 2,-1, 0, 1,  -1, 0, 2, 1,-2,
     0, 3,-1, 2, 1,   1,-2, 0, 1, 2,  -1, 2, 0,-1, 3,   2, 0,-1, 1, 0,
    -1, 0, 2, 1,-2,   0, 1,-1, 2, 0,   1, 2,-1, 0, 1,   0,-1, 2, 1,-1,
    /* conv2: 640 values (filled with repeating pattern for size) */
#define C2V (i*7%5 - 2)
    /* (explicit small set repeated; real build is data-driven) */
    1,-1,2,0,-2,1,0, 1,-1,2,0,-2,1,0, 1,-1,2,0,-2,1,0, 1,-1,2,0,-2,1,0,
    1,-1,2,0,-2,1,0, 1,-1,2,0,-2,1,0, 1,-1,2,0,-2,1,0, 1,-1,2,0,-2,1,0,
    1,-1,2,0,-2,1,0, 1,-1,2,0,-2,1,0, 1,-1,2,0,-2,1,0, 1,-1,2,0,-2,1,0,
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    1,-1,2,0,-2,1,0, 1,-1,2,0,-2,1,0, 1,-1,2,0,-2,1,0, 1,-1,2,0,-2,1,0,
#undef C2V
    /* conv3: 1536 values — use memset-fill at runtime instead of literal.
     * We declare the space and fill in tflite_init(). */
    /* conv4: 6144 values — same. */
    /* fc:   3584 values — same. */
};

/* To keep the firmware self-contained without a 12 KB literal, we store the
 * remaining weight regions in a static mutable array filled at init time. */
static int8_t  g_w_conv3[W_CONV3];
static int8_t  g_w_conv4[W_CONV4];
static int8_t  g_w_fc[W_FC];
static int32_t g_b_conv1[8]   = { 0 };
static int32_t g_b_conv2[16]  = { 0 };
static int32_t g_b_conv3[32]  = { 0 };
static int32_t g_b_conv4[64]  = { 0 };
static int32_t g_b_fc[56]     = { 0 };

static int g_inited = 0;

static void tflite_init(void)
{
    /* Fill placeholder weight regions deterministically. Real builds load
     * these from flash page 0x08008000. */
    for (int i = 0; i < W_CONV3; i++) g_w_conv3[i] = (int8_t)((i * 13) % 7 - 3);
    for (int i = 0; i < W_CONV4; i++) g_w_conv4[i] = (int8_t)((i * 17) % 7 - 3);
    for (int i = 0; i < W_FC;   i++) g_w_fc[i]    = (int8_t)((i * 23) % 7 - 3);
    for (int i = 0; i < 8;  i++) g_b_conv1[i] = 0;
    for (int i = 0; i < 16; i++) g_b_conv2[i] = 0;
    for (int i = 0; i < 32; i++) g_b_conv3[i] = 0;
    for (int i = 0; i < 64; i++) g_b_conv4[i] = 0;
    for (int i = 0; i < 56; i++) g_b_fc[i]    = 0;
    g_inited = 1;
}

/* ---- ReLU helper --------------------------------------------------- */
static inline int32_t relu_i32(int32_t x) { return x > 0 ? x : 0; }

/* ---- 1-D convolution (no padding, stride s) ----------------------- */
static void conv1d(const int8_t *in, int in_t, int in_ch,
                   const int8_t *w, const int32_t *b,
                   int out_ch, int k, int stride,
                   int8_t *out, int *out_t)
{
    int ot = (in_t - k) / stride + 1;
    *out_t = ot;
    for (int oc = 0; oc < out_ch; oc++) {
        for (int t = 0; t < ot; t++) {
            int32_t acc = b ? b[oc] : 0;
            for (int c = 0; c < in_ch; c++) {
                for (int kk = 0; kk < k; kk++) {
                    int idx = (t * stride + kk) * in_ch + c;
                    acc += (int32_t)in[idx] * (int32_t)w[(oc * in_ch + c) * k + kk];
                }
            }
            /* int32 → int8 with a fixed scale of 1/64 (representative). */
            int32_t q = relu_i32(acc) >> 6;
            if (q > 127)  q = 127;
            if (q < -128) q = -128;
            out[t * out_ch + oc] = (int8_t)q;
        }
    }
}

/* ---- Average pool over time --------------------------------------- */
static void avgpool_time(const int8_t *in, int t, int ch, int8_t *out)
{
    for (int c = 0; c < ch; c++) {
        int32_t acc = 0;
        for (int i = 0; i < t; i++) acc += in[i * ch + c];
        int32_t q = acc / t;
        if (q > 127) q = 127; if (q < -128) q = -128;
        out[c] = (int8_t)q;
    }
}

/* ---- Fully-connected layer --------------------------------------- */
static void linear(const int8_t *in, int in_dim,
                   const int8_t *w, const int32_t *b,
                   int out_dim, int16_t *out)
{
    for (int o = 0; o < out_dim; o++) {
        int32_t acc = b ? b[o] : 0;
        for (int i = 0; i < in_dim; i++) {
            acc += (int32_t)in[i] * (int32_t)w[o * in_dim + i];
        }
        out[o] = (int16_t)(acc >> 4);   /* down-scale to fit int16 */
    }
}

/* ---- Main classifier --------------------------------------------- */
int tflite_classify(const trajectory_t *t, inference_result_t *r)
{
    if (!g_inited) tflite_init();
    if (!t || !r) return -1;

    /* Build the 64×3 int8 input from the trajectory. */
    static int8_t input[TRAJ_NPOINTS * TRAJ_CHANNELS];
    for (int i = 0; i < TRAJ_NPOINTS; i++) {
        input[i*3+0] = (int8_t)(t->x[i] >> 8);
        input[i*3+1] = (int8_t)(t->y[i] >> 8);
        input[i*3+2] = (int8_t)(t->v[i] >> 8);
    }

    /* Layer 1: Conv1D(8, k=5, stride=1) → 64×8 */
    static int8_t buf1[TRAJ_NPOINTS * 8];
    int t1;
    conv1d(input, TRAJ_NPOINTS, 3, g_weights, g_b_conv1, 8, 5, 1, buf1, &t1);

    /* Layer 2: Conv1D(16, k=5, stride=2) → 30×16 */
    static int8_t buf2[TRAJ_NPOINTS * 16];
    int t2;
    conv1d(buf1, t1, 8, g_weights + W_CONV1, g_b_conv2, 16, 5, 2, buf2, &t2);

    /* Layer 3: Conv1D(32, k=3, stride=2) → 14×32 */
    static int8_t buf3[TRAJ_NPOINTS * 32];
    int t3;
    conv1d(buf2, t2, 16, g_w_conv3, g_b_conv3, 32, 3, 2, buf3, &t3);

    /* Layer 4: Conv1D(64, k=3, stride=1) → 12×64 */
    static int8_t buf4[TRAJ_NPOINTS * 64];
    int t4;
    conv1d(buf3, t3, 32, g_w_conv4, g_b_conv4, 64, 3, 1, buf4, &t4);

    /* Average pool over time → 64 */
    static int8_t pooled[64];
    avgpool_time(buf4, t4, 64, pooled);

    /* FC → 56 logits */
    linear(pooled, 64, g_w_fc, g_b_fc, 56, r->logits);

    /* Argmax + crude softmax (max-normalized). */
    int16_t maxl = r->logits[0];
    int maxc = 0;
    for (int i = 1; i < N_CLASSES; i++) {
        if (r->logits[i] > maxl) { maxl = r->logits[i]; maxc = i; }
    }
    r->pred_class = (int8_t)maxc;

    /* Confidence = exp(z_max - z_runner_up) / (1 + that). */
    int16_t runner = -32768;
    for (int i = 0; i < N_CLASSES; i++) {
        if (i == maxc) continue;
        if (r->logits[i] > runner) runner = r->logits[i];
    }
    int16_t gap = maxl - runner;
    if (gap < 0) gap = 0;
    if (gap > 10) gap = 10;
    r->confidence_x1k = (int16_t)(1000 * gap / (gap + 8));

    return 0;
}

int tflite_load_weights(const uint8_t *blob, uint32_t len)
{
    /* A real implementation validates a CRC32 trailer and copies the body
     * to flash page 0x08008000. Here we accept the blob into RAM for the
     * conv3/conv4/fc regions (which are mutable). */
    if (!blob || len < TOTAL_W) return -1;
    memcpy(g_w_conv3, blob + W_CONV1 + W_CONV2, W_CONV3);
    memcpy(g_w_conv4, blob + W_CONV1 + W_CONV2 + W_CONV3, W_CONV4);
    memcpy(g_w_fc,    blob + W_CONV1 + W_CONV2 + W_CONV3 + W_CONV4, W_FC);
    return 0;
}