/*
 * sipm.c — SiPM bias voltage control via AD5689 DAC
 * Author: jayis1
 * Copyright (c) 2026 jayis1. All rights reserved.
 * License: MIT
 *
 * The SiPM bias is generated by a programmable boost converter whose
 * feedback node is driven by the AD5689 dual-channel 16-bit DAC over
 * I²C. We compute the DAC code from the requested bias voltage and
 * apply temperature compensation per the MICROFC-SMA datasheet:
 *   V_bias(T) = V_breakdown(25 °C) + 27.5 mV * (T - 25)
 * with the overvoltage held at a constant 2.5 V above breakdown.
 */
#include "sipm.h"
#include "registers.h"
#include "board.h"

/* I²C helpers — shared with other drivers via i2c.c, but kept local here
 * so this driver is self-contained for review.
 */
extern muon_status_t i2c_write(uint8_t addr, const uint8_t *data, uint16_t n);
extern muon_status_t i2c_read(uint8_t addr, uint8_t *data, uint16_t n);

static uint32_t s_bias_mv = 0;
static float    s_last_temp_c = 25.0f;
static uint8_t  s_dac_code_hi = 0;
static uint8_t  s_dac_code_lo = 0;

/* Boost converter gain: 1 DAC LSB at the feedback node = 4.0 mV at the
 * output (set by Rfb = 200 kΩ, Rdiv = 6.8 kΩ). DAC range 0..65535 -> 0..262 V.
 */
#define BOOST_GAIN_MV_PER_LSB 4.0f

muon_status_t sipm_init(void)
{
    /* AD5689 power-up, internal reference on, gain x2 (0..5 V span) */
    uint8_t cmd[3] = { 0x40, 0x00, 0x01 };  /* power-up, ref on, x2 */
    MUON_RETURN_ON_ERR(i2c_write(ADDR_SIPM_DAC, cmd, 3));
    s_bias_mv = 0;
    return MUON_OK;
}

muon_status_t sipm_set_bias_mv(uint32_t mv)
{
    if (mv < SIPM_BIAS_MIN_MV || mv > SIPM_BIAS_MAX_MV)
        return MUON_ERR_INVALID_ARG;

    float code_f = (float)mv / BOOST_GAIN_MV_PER_LSB;
    uint16_t code = (uint16_t)(code_f + 0.5f);
    if (code > 65535) code = 65535;

    uint8_t cmd[3] = { 0x18, (uint8_t)(code >> 8), (uint8_t)(code & 0xFF) };
    /* 0x18 = write to DAC channel A, update immediately */
    MUON_RETURN_ON_ERR(i2c_write(ADDR_SIPM_DAC, cmd, 3));

    s_bias_mv = mv;
    s_dac_code_hi = (uint8_t)(code >> 8);
    s_dac_code_lo = (uint8_t)(code & 0xFF);
    return MUON_OK;
}

uint32_t sipm_get_bias_mv(void) { return s_bias_mv; }

muon_status_t sipm_temp_compensate(float temp_c)
{
    s_last_temp_c = temp_c;
    /* Recompute target bias: nominal 15.7 V at 25 °C, -27 mV/°C */
    int32_t delta_mv = (int32_t)(SIPM_TEMP_COEFF_MV_PER_C * (temp_c - 25.0f));
    int32_t target = (int32_t)SIPM_BIAS_DEFAULT + delta_mv;
    if (target < (int32_t)SIPM_BIAS_MIN_MV) target = SIPM_BIAS_MIN_MV;
    if (target > (int32_t)SIPM_BIAS_MAX_MV) target = SIPM_BIAS_MAX_MV;
    return sipm_set_bias_mv((uint32_t)target);
}

void sipm_disable(void)
{
    uint8_t cmd[3] = { 0x18, 0x00, 0x00 };  /* DAC = 0 */
    i2c_write(ADDR_SIPM_DAC, cmd, 3);
    s_bias_mv = 0;
}

/* SiPM current is read by the BQ76952 coulomb counter (channel for the
 * 15.7 V rail); the application queries this. Here we return a cached
 * value updated by the power driver's poll loop.
 */
static float s_cached_current_ma = 0.0f;
void sipm_set_current_ma(float ma) { s_cached_current_ma = ma; }
float sipm_get_current_ma(void)   { return s_cached_current_ma; }